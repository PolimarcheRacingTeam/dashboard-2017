#define F_CPU 1000000UL
#include <avr/io.h>
#include <util/delay.h>
#include <stdlib.h>
#include "stlcd.h"
#include "glcd.h"

int pagemap[] = {7, 6, 5, 4, 3, 2, 1, 0 };
uint8_t gearString[]={'G','e','a','r',' ','0','\0'};
uint8_t waterString[]={'W','a','t','e','r',' ','0','0','0',' ','C','\0'};
uint8_t oilString[]={'O','i','l',' ','0',',','0',' ','b','a','r','\0'};
uint8_t batteryString[]={'B','a','t','t',' ','0','0',',','0',' ','V','\0'};
uint8_t lambdaString[]={'L','a','m','b','d','a',' ','0',',','0','0','\0'};//ho aggiunto la stringa per la lambda
uint8_t oilTString[]={'O','i','l','T','.',' ',' ','0','0',' ','C','\0'};
	

uint8_t buffer[128*64/8] = {
	0x00,0x00,0x00,0x00,0x00,0x00,0x00,0x00,0x00,0x00,0x00,0x00,0x00,0x00,0x00,0x00,
	0x00,0x00,0x00,0x00,0x00,0x00,0x00,0x00,0x00,0x00,0x00,0x00,0x00,0x00,0x00,0x00,
	0x00,0x00,0x00,0x00,0x00,0x00,0x00,0x00,0x00,0x00,0x00,0x00,0x00,0x00,0x00,0x00,
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	0x00,0x00,0x00,0x00,0x00,0x00,0x00,0x00,0x00,0x00,0x00,0x00,0x00,0x00,0x00,0x00
};

void display_init(void) 
{
    st7565_init();

    
    st7565_command(CMD_SET_ALLPTS_NORMAL);
    st7565_set_brightness(0x10);
    clear_screen();
	
    write_buffer(buffer);
	st7565_command(CMD_DISPLAY_ON);
}

void display_update(char gear, char water,char oil, char battery, char lambda,char oilT)//ricevo il dato della lambda e lo lavoro per mostrarlo 
{
	gearString[5]=gear+48;
	char temp=water%100;
	if(water<100)
		waterString[6]=' ';
	else
		waterString[6]=(water/100)+48;	
		
	waterString[7]=(temp/10)+48;
	waterString[8]=(temp%10)+48;
	
	temp=oil%100;
	oilString[4]=(temp/10)+48;
	oilString[6]=(temp%10)+48;
	
	temp=battery%100;
	batteryString[5]=(battery/100)+48;
	batteryString[6]=(temp/10)+48;
	
	//batteryString[5]='a';
	//batteryString[6]='b';
	batteryString[8]=(temp%10)+48;
	
	
	lambdaString[7]=lambda*0.032+48;
	lambdaString[9]=(uint8_t)(lambda*0.32)%10+48;
	lambdaString[10]=(uint16_t)(lambda*3.2)%10+48;
	
	/*
	conti per la temperatura dell'olio
	*/
	oilTString[7]=(oilT/10)+48;
	oilTString[8]=(oilT%10)+48;
	
	clear_buffer(buffer);
	
	//drawstring(buffer,30,1, gearString);//ricordati di togliere le marcie
	drawstring(buffer,30,3, oilTString);//manca la temperatura dell'olio che mi deve passare Seb
	drawstring(buffer, 30, 2, waterString);
	drawstring(buffer,30,5, lambdaString);//mostro la stringa della lambda
	drawstring(buffer, 30, 4, oilString);
	drawstring(buffer, 30, 6, batteryString);
	write_buffer(buffer);
}


void testdrawchar(uint8_t *buff) {
  for (uint8_t i=0; i < 168; i++) {
    drawchar(buffer, (i % 21) * 6, i/21, i);
  }    
}

void testdrawcircle(uint8_t *buff) {
  for (uint8_t i=0; i<64; i+=2) {
    drawcircle(buffer, 63, 31, i, 1);
  }
}

void testdrawline(uint8_t *buff) {
  for (uint8_t i=0; i<128; i+=4) {
    drawline(buffer, 0, 0, i, 63, 1);
	
  }
  for (uint8_t i=0; i<64; i+=4) {
    drawline(buffer, 0, 0, 127, i, 1);
  }

  write_buffer(buffer);
  _delay_ms(1000);

  for (uint8_t i=0; i<128; i+=4) {
    drawline(buffer, i, 63, 0, 0, 0);
  }
  for (uint8_t i=0; i<64; i+=4) {
    drawline(buffer, 127, i, 0, 0, 0);
  }
}

void testdrawrect(uint8_t *buff) {
  for (uint8_t i=0; i<64; i+=2) {
    drawrect(buff, i, i, 128-i, 64-i, 1);

  }
}


void testfillrect(uint8_t *buff) {
  for (uint8_t i=0; i<64; i++) {
    fillrect(buff, i, i, 128-i, 64-i, i%2);

  }
}

void clear_screen(void) {
  uint8_t p, c;
  
  for(p = 0; p < 8; p++) {
    st7565_command(CMD_SET_PAGE | p);
    for(c = 0; c < 129; c++) {
      //uart_putw_dec(c);
      //uart_putchar(' ');
      st7565_command(CMD_SET_COLUMN_LOWER | (c & 0xf));
      st7565_command(CMD_SET_COLUMN_UPPER | ((c >> 4) & 0xf));
      st7565_data(0x0);
    }     
  }
}


void st7565_init(void) {
  // set pin directions
  SID_DDR |= _BV(SID);
  SCLK_DDR |= _BV(SCLK);
  A0_DDR |= _BV(A0);
  RST_DDR |= _BV(RST);
  CS_DDR |= _BV(CS);
  
  // toggle RST low to reset; CS low so it'll listen to us
  CS_PORT &= ~_BV(CS);
  RST_PORT &= ~_BV(RST);
  _delay_ms(500);
  RST_PORT |= _BV(RST);

  // LCD bias select
  st7565_command(CMD_SET_BIAS_7);
  // ADC select
  st7565_command(CMD_SET_ADC_REVERSE);
  // SHL select
  st7565_command(CMD_SET_COM_REVERSE);
  // Initial display line
  st7565_command(CMD_SET_DISP_START_LINE);

  // turn on voltage converter (VC=1, VR=0, VF=0)
  st7565_command(CMD_SET_POWER_CONTROL | 0x4);
  // wait for 50% rising
  _delay_ms(50);

  // turn on voltage regulator (VC=1, VR=1, VF=0)
  st7565_command(CMD_SET_POWER_CONTROL | 0x6);
  // wait >=50ms
  _delay_ms(50);

  // turn on voltage follower (VC=1, VR=1, VF=1)
  st7565_command(CMD_SET_POWER_CONTROL | 0x7);
  // wait
  _delay_ms(10);

  // set lcd operating voltage (regulator resistor, ref voltage resistor)
  st7565_command(CMD_SET_RESISTOR_RATIO | 0x6);
}

inline void spiwrite(uint8_t c) {
  int8_t i;
  for (i=7; i>=0; i--) {
    SCLK_PORT &= ~_BV(SCLK);
    if (c & _BV(i))
      SID_PORT |= _BV(SID);
    else
      SID_PORT &= ~_BV(SID);
    SCLK_PORT |= _BV(SCLK);
  }
}
void st7565_command(uint8_t c) {
  A0_PORT &= ~_BV(A0);

  spiwrite(c);
}

void st7565_data(uint8_t c) {
  A0_PORT |= _BV(A0);

  spiwrite(c);
}
void st7565_set_brightness(uint8_t val) {
    st7565_command(CMD_SET_VOLUME_FIRST);
    st7565_command(CMD_SET_VOLUME_SECOND | (val & 0x3f));
}


void write_buffer(uint8_t *buffer) {
  uint8_t c, p;

  for(p = 0; p < 8; p++) {

    st7565_command(CMD_SET_PAGE | pagemap[p]);
    st7565_command(CMD_SET_COLUMN_LOWER | (0x0 & 0xf));
    st7565_command(CMD_SET_COLUMN_UPPER | ((0x0 >> 4) & 0xf));
    st7565_command(CMD_RMW);
    st7565_data(0xff);
    
    for(c = 0; c < 128; c++) {
      st7565_data(buffer[(128*p)+c]);
    }
  }
}

